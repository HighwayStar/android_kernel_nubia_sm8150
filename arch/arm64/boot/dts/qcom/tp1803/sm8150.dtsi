&firmware {
        android {
                 fstab {
                        vendor {
                                fsmgr_flags = "wait,avb";
                        };
                 };
        };
};

