## drivers/nubia/touch/hxchipset/Kconfig
```kconfig
#
# Himax Touchscreen driver configuration
#

config TOUCHSCREEN_HIMAX_I2C_NUBIA
	tristate "HIMAX chipset i2c touchscreen"
		depends on NUBIA_TOUCHSCREEN_HXCHIPSET
	help
	  This enables support for HIMAX CHIPSET over I2C based touchscreens.

# ***************** In-cell Start *****************
config TOUCHSCREEN_HIMAX_INCELL_NUBIA
	tristate "HIMAX chipset in-cell function"
	depends on TOUCHSCREEN_HIMAX_I2C_NUBIA
	help
	  This enables support for HIMAX CHIPSET of in-cell function.

config TOUCHSCREEN_HIMAX_IC_HX83112_NUBIA
	tristate "HIMAX chipset HX83112 function"
	depends on TOUCHSCREEN_HIMAX_INCELL_NUBIA
	help
	  This enables support for HIMAX CHIPSET of HX83112.

# ***************** In-cell End *******************

config TOUCHSCREEN_HIMAX_DEBUG_NUBIA
	tristate "HIMAX debug function"
	depends on TOUCHSCREEN_HIMAX_I2C_NUBIA
	help
	  This enables support for HIMAX debug function.


config HMX_DB_NUBIA
	tristate "HIMAX driver test over Dragon Board"
	depends on TOUCHSCREEN_HIMAX_I2C_NUBIA
	help
	  This enables support for HIMAX driver test over Dragon Board.
```

## drivers/platform/nubia/Kconfig
```kconfig
# Nubia configuration options

config MACH_NUBIA
    bool "NUBIA device"
    help
      Support for Nubia products

config MACH_NUBIA_SM8150
    bool "NUBIA SM8150"
    depends on ARCH_SM8150
    select MACH_NUBIA
    help
      Support for SM8150 Nubia variants

menu "Nubia board selection"

config MACH_NUBIA_TP1803
    bool "NUBIA_TP1803 board"
    select MACH_NUBIA_SM8150
    help
      Support for Nubia mini 5g (TP1803) variant

endmenu
```
